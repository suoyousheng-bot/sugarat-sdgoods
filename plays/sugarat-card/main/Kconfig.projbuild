## plays/sugarat-card/main/Kconfig.projbuild
```kconfig
menu "Sugarat social card"
config CARD_WIFI_CHANNEL
    int "Shared ESP-NOW and editor Wi-Fi channel"
    range 1 11
    default 1
config CARD_EDIT_SECONDS
    int "Temporary editing access-point lifetime in seconds"
    range 60 900
    default 300
endmenu
```

## plays/sugarat-cover/main/Kconfig.projbuild
```kconfig
menu "Sugarat Cover"
config COVER_CHANNEL
    int "Nearby sharing Wi-Fi channel"
    range 1 11
    default 6
    help
        All participating badges must use the same 2.4 GHz channel.
endmenu
```

## plays/sugarat-fluid/main/Kconfig.projbuild
```kconfig
menu "Sugarat Magic Bottle"
config BOTTLE_RADIO_CHANNEL
    int "Nearby ESP-NOW channel (same on both bottles)"
    range 1 11
    default 6
endmenu
```

## plays/sugarat-pet/main/Kconfig.projbuild
```kconfig
menu "Sugarat pet"
config PET_SOCIAL_CHANNEL
    int "ESP-NOW nearby channel"
    range 1 11
    default 1
    help
        Both nearby devices must use the same 2.4 GHz channel.
endmenu
```

## plays/sugarat-race/main/Kconfig.projbuild
```kconfig
menu "Sugarat Racing"
config RACE_RADIO_CHANNEL
    int "Nearby racing radio channel"
    range 1 11
    default 6
endmenu
```
