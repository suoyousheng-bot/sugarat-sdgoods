## assets/components/deotaland-agent-link/components/sugarat_agent_link/Kconfig
```kconfig
menu "Deotaland Agent Link"

config SUGARAT_AGENT_LINK_BASE_URL
    string "Platform origin"
    default "https://bot.deotaland.cn"
    help
        HTTPS origin of the Deotaland device gateway, without a trailing slash.

config SUGARAT_AGENT_LINK_PRODUCT_ID
    int "Platform product id"
    default 0
    help
        Product id registered on the Deotaland platform for this device. The device sends it
        only when it requests an activation code. The build fails while it is 0.

config SUGARAT_AGENT_LINK_CHIP_TYPE
    string "Reported chip type"
    default "esp32-s3"
    help
        Chip type sent with the activation request. The platform rejects activation with
        chipTypeMismatch unless this equals the chip registered for the product.

endmenu
```

## assets/components/wifi-provisioning/components/sugarat_wifi/Kconfig
```kconfig
menu "Sugarat Wi-Fi provisioning"

config SUGARAT_WIFI_MAX_TX_POWER_DBM
    int "Maximum Wi-Fi transmit power (dBm)"
    range 2 20
    default 20
    help
        Limit radio transmit power before scans and saved-network reconnects.
        Select a value verified on the target board and power supply. The
        Wi-Fi driver maps this limit to its supported power levels.

endmenu
```

## main/Kconfig.projbuild
```kconfig
menu "Sugarat Launcher"

    config LAUNCHER_COMMUNITY_URL
        string "Community service base URL"
        default "http://3.144.1.190:9004"
        help
          Base URL of the Sugarat play community service, without a trailing slash.
          The launcher reads public play details and download tickets from it.

    config LAUNCHER_PRODUCT_ID
        int "Community product ID of this device"
        default 1
        help
          Plays whose published version targets another product are shown as incompatible.

    config LAUNCHER_HARDWARE_REVISION_ID
        int "Community hardware revision ID of this device"
        default 1

    config LAUNCHER_SERIAL_TEST_INPUT
        bool "Serial taps, swipes and screenshots for on-device UI checks"
        default y
        help
          Starts the board serial console with screenshot capture and accepts the synthetic
          touch commands documented in main/launcher_console.c.

endmenu
```

## plays/sugarat-radio/components/sugarat_wifi/Kconfig
```kconfig
# Modified for Sugarat Radio by Deotaland, 2026: US channel policy.
menu "Sugarat Wi-Fi provisioning"

config SUGARAT_WIFI_US_CHANNELS
    bool "Use US channels 1-11"
    default y
    help
        Fix the US country policy before the first scan or reconnect.

config SUGARAT_WIFI_MAX_TX_POWER_DBM
    int "Maximum Wi-Fi transmit power (dBm)"
    range 2 20
    default 20
    help
        Limit radio transmit power before scans and saved-network reconnects.
        Select a value verified on the target board and power supply. The
        Wi-Fi driver maps this limit to its supported power levels.

endmenu
```

## plays/sugarat-radio/components/sugarat_wifi_ui/Kconfig
```kconfig
menu "Sugarat Wi-Fi setup"
config SUGARAT_WIFI_UI
    bool "Enable round-screen Wi-Fi setup"
    default y
endmenu
```

## plays/sugarat-radio/main/Kconfig.projbuild
```kconfig
menu "Sugarat Radio"
config SUGARAT_RADIO_CURATED_URL
    string "HTTPS URL of the Sugarat US station JSON array"
    default ""
    help
        Empty disables the hosted list. Failure falls back to Radio Browser,
        then the bundled development list. No service is provisioned by firmware.
config SUGARAT_RADIO_BROWSER_URL
    string "Radio Browser HTTPS server"
    default "https://de1.api.radio-browser.info"
config SUGARAT_RADIO_DEFAULT_TIMEZONE
    string "POSIX timezone for nationwide mode"
    default "EST5EDT,M3.2.0/2,M11.1.0/2"
endmenu
```
